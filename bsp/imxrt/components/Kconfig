## bsp/imxrt/components/Kconfig
```kconfig
menu "NXP Software Components"

	menu "MicroPython"
	config NXP_USING_MICROPYTHON
			bool "MicroPython: Python implementation for MCU."
    		select RT_USING_LIBC
    		select RT_USING_RTC
    		default n
	if NXP_USING_MICROPYTHON	
		menu "Hardware Module"
	        config MICROPYTHON_USING_MACHINE_I2C
	            bool "machine i2c: enable i2c functions for machine module"
	            select RT_USING_I2C
	            default n
	
	        config MICROPYTHON_USING_MACHINE_SPI
	            bool "machine spi: enable spi functions for machine module"
	            select RT_USING_SPI
	            default n
	
	        config MICROPYTHON_USING_MACHINE_UART
	            bool "machine uart: enable uart functions for machine module"
	            select RT_USING_SERIAL
	            default n
	
	        config MICROPYTHON_USING_MACHINE_RTC
	            bool "machine rtc: enable rtc functions for machine module"
	            select RT_USING_RTC
	            default n
	
	        config MICROPYTHON_USING_MACHINE_PWM
	            bool "machine pwm: enable pwm functions for machine module"
	            select RT_USING_PWM
	            default n
	
	        config MICROPYTHON_USING_MACHINE_ADC
	            bool "machine adc: enable adc functions for machine module"
	            select RT_USING_ADC
	            default n
	            
	        config MICROPYTHON_USING_MACHINE_WDT
	            bool "machine watchdog: enable watchdog functions for machine module"
	            select RT_USING_WDT
	            default n
	       
	        config MICROPYTHON_USING_MACHINE_TIMER
	            bool "machine timer: enable timer functions for machine module"
	            select RT_USING_HWTIMER
	            default n
	
	        config MICROPYTHON_USING_NETWORK
	            bool "network: network drivers and routing configuration"
	            default n
	
	        if MICROPYTHON_USING_NETWORK
	            config MICROPYTHON_USING_WLAN
	            bool "network.WLAN: network WLAN framework configuration"
	            default n
	        endif
	
	        config MICROPYTHON_USING_MACHINE_LCD
	            bool "machine LCD: enable LCD functions for machine module"
	            select BSP_USING_LCD
	            select MICROPYTHON_USING_UOS
	            default n
			
			config MICROPY_HW_ENABLE_RNG
				bool "pyb RNG: enable RNG in pyb module"
				default y
				
			config MICROPY_HW_ENABLE_LED
				bool "pyb LED: enable LED functions for machine/pyb module"
				default y
			if MICROPY_HW_ENABLE_LED
			config MICROPY_HW_LED_NUM
				int "pyb LED: LED Number"
				range 0,4
				default 1
				
			endif
			config MICROPY_HW_ENABLE_SERVO
				bool "SERVO: enable servo for pyb module"
				default n
	    endmenu
	
	    menu "System Module"
	    	config MICROPY_QSTR_BYTES_IN_HASH
	    		int "QString length"
	    		range 1 2
	    		default 2
	    		
	        config MICROPYTHON_USING_UOS
	            bool "uos: basic 'operating system' services"
	            select RT_USING_DFS
	            default n
	
	        if MICROPYTHON_USING_UOS
	            config MICROPYTHON_USING_FILE_SYNC_VIA_IDE
	                bool "filesync: sync files through MicroPython IDE"
	                default y
	        endif
	
	        config MICROPYTHON_USING_THREAD
	            bool "_thread: multithreading support"
	            default n
	
	        config MICROPYTHON_USING_USELECT
	            bool "uselect: wait for events on a set of streams"
	            default n
	
	        config MICROPYTHON_USING_UCTYPES
	            bool "uctypes: create and manipulate C data types in Python"
	            default n
	
	        config MICROPYTHON_USING_UERRNO
	            bool "uerrno: system error codes"
	            default n
	
	        if PKG_MICROPYTHON_VER_NUM > 0x11000
	            config MICROPYTHON_USING_FFI
	                bool "ffi: foreign function interface for native program"
	                select RT_USING_MODULE
	                default n
	        endif
	    endmenu
	
	    menu "Tools Module"
	        config MICROPYTHON_USING_CMATH
	            bool "cmath: mathematical functions for complex numbers"
	            default n
	
	        config MICROPYTHON_USING_UBINASCII
	            bool "ubinascii: binary/ASCII conversions"
	            default n
	
	        config MICROPYTHON_USING_UHASHLIB
	            bool "uhashlib: hashing algorithms"
	            default n
	
	        config MICROPYTHON_USING_UHEAPQ
	            bool "uheapq: heap queue algorithm"
	            default n
	
	        config MICROPYTHON_USING_UJSON
	            bool "ujson: JSON encoding and decoding"
	            select MICROPYTHON_USING_UOS
	            default n
	
	        config MICROPYTHON_USING_URE
	            bool "ure: simple regular expressions"
	            default n
	
	        config MICROPYTHON_USING_UZLIB
	            bool "uzlib: zlib decompression"
	            default n
	
	        config MICROPYTHON_USING_URANDOM
	            bool "urandom: random variable generators"
	            default n
	    endmenu
	
	    menu "Network Module"
	        config MICROPYTHON_USING_USOCKET
	            bool "usocket: socket operations and some related functions"
	            select RT_USING_SAL
	            select SAL_USING_POSIX
	            select RT_LWIP_IGMP
	            default n
	
	        config MICROPYTHON_USING_USSL
	            bool "ussl: secure sockets layer for https protocol"
	            select PKG_USING_MBEDTLS
	            default n
	    endmenu

		config MICROPYTHON_USING_LVGL
			bool "LVGL -- GUI Library"
			select BSP_USING_HWTIMER
			select BSP_USING_HWTIMER1
			select RT_USING_TOUCH
			default n 
	
	    config PKG_MICROPYTHON_HEAP_SIZE
	        int
	        prompt "Heap size for python run environment"
	        default 131072
		
		config NXP_MICROPYTHON_THREAD_STACK_SIZE
			int "Thread Stack Size"
			default 32768

		config NXP_MICROPYTHON_AUTO_START
			bool "Auto start the python after bootup"
			default n	
		
	endif        
	endmenu
	menu "OpenMV"
		config NXP_USING_OPENMV
			bool "Enable OpenMV from NXP ported"
			select NXP_USING_MICROPYTHON
			select RT_USING_CSI
			default n
		config NXP_USING_NNCU 
			bool "Enable the NNCU engine"
			default y
			depends on NXP_USING_OPENMV
			
		config WEIT_CACHE_SIZE
			int "Weit Cache Size"
			default 61440
			depends on NXP_USING_NNCU
			
		config NXP_USING_OMV_TFLITE
			bool "Enable the tflite engine"
			default y 
			depends on NXP_USING_OPENMV
			
		config NXP_USING_GLOW 
			bool "Enable the Glow engine"
			default y
			depends on NXP_USING_OPENMV
			
		config NXP_OMV_AUTO_START
			bool "Start OpenMV thread after bootup"
			default n
			depends on NXP_USING_OPENMV
		
	endmenu
	
endmenu
```

## bsp/imxrt/imxrt1062-nxp-evk/Kconfig
```kconfig
mainmenu "RT-Thread Configuration"

config RTT_DIR
    string
    option env="RTT_ROOT"
    default "../../.."

config PKGS_DIR
    string
    option env="PKGS_ROOT"
    default "packages"

#kernel configuration
source "$RTT_DIR/Kconfig"

source "$PKGS_DIR/Kconfig"
#driver configuration
source "../libraries/Kconfig"
#board hardware configuration
source "board/Kconfig"
#nxp software component configuration
source "../components/Kconfig"
```
