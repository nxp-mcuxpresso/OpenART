#!armclang -E --target=arm-arm-none-eabi -mcpu=cortex-m7 -xc

#define STACK_SIZE 0x2000
#define ROM_BASE	0x80000000
#define IVT_BASE	0x80001000
#define ITCM_SIZE	32*1024

#define OMV_MAIN_FB_SIZE	(4*720*1280) //301*1024
#define OMV_FB_ALLOC_OVERLAY_SIZE	120*1024 //83*1024
#define OMV_FB_ALLOC_SIZE  1536*1024
; must use "VECTOR_RAM", "RW_m_data", "VECTOR_ROM" as names to work with "InstallIRQHandler()" API
#include "../../rtconfig.h"
LR_XIP_FLASH_INFO ROM_BASE  {
  ; >>> RO regions
	RW_m_config_text +0 0xF000 {
	* (.boot_hdr.conf, +FIRST)
	}
}

LR_XIP_FLASH_IVT IVT_BASE {
	ER_boot_hdr_ivt +0 0x20 {
	* (.boot_hdr.ivt)
	}
	ER_boot_hdr_boot_data +0 0x10{
	* (.boot_hdr.boot_data)
	}  
	ER_boot_hdr_dcd_data +0 {
	* (.boot_hdr.dcd_data)
	}
}

LR_XIP_FLASH ROM_BASE + 0x2000 {
	VECTOR_ROM +0 0x400 { ; vector table
		* (RESET,+FIRST)
		* (InRoot$$Section)
	}
	
	TEXT_ROM +0  { ; load address = execution address
		.ANY (+RO)
	}


	ER_ITCM 0 ITCM_SIZE - STACK_SIZE { ; Stack region growing down
		gc.o rt_mem*.o (+RO)
		collections.o array.o xalloc.o (+RO)
		arm_nn_mat*.o (+RO)
	}
	ARM_LIB_STACK ITCM_SIZE - STACK_SIZE EMPTY STACK_SIZE {}
	
    DTCM_START_PLACEHOLDER 0x20000000 EMPTY 0 {}
	ARM_LIB_HEAP +0 EMPTY 0x300 {}; Heap region growing up

	ER_DTCM +0 {
		.ANY (+RW, +ZI)
		* (.jpeg_buf)
		sincos_tab.o (+RO)
	}
	WEIT_CACHE_AREA +0 EMPTY WEIT_CACHE_SIZE {}
	OMV_FB_ALLOC_OVERLAY +0 EMPTY OMV_FB_ALLOC_OVERLAY_SIZE {}
	OMV_FB_ALLOC_OVERLAY_END +0 EMPTY 0 {}	
	DTCM_END_PLACEHOLDER 0x20078000 EMPTY 0 {}

	RW_DATA_SRAM 0x80260000  EMPTY 0 {}
	
	#define RTT_HEAP_SIZE 128*1024
	RTT_HEAP +0 EMPTY RTT_HEAP_SIZE{} 
#if defined(NXP_USING_MICROPYTHON) 
	
	RTT_MPY_THREAD_STACK +0 EMPTY NXP_MICROPYTHON_THREAD_STACK_SIZE{}
#endif	
	
	MPY_HEAP_START +0 EMPTY PKG_MICROPYTHON_HEAP_SIZE{}
	; <<<
	MPY_SENSOR_BUFER_START	+0 EMPTY 6*1024*1024{}
	OMV_MAIN_FB +0 EMPTY OMV_MAIN_FB_SIZE  + OMV_FB_ALLOC_SIZE {}
//	OMV_FB_ALLOC +0 EMPTY OMV_FB_ALLOC_SIZE {}
	OMV_FB_END +0 EMPTY 16 {}
	; >>> SDRAM >>>
	ER_LCD_FB +0 UNINIT 1024*1024  {
		* (.lcd_fb)
	}
	RW_SRAM_END 0x81E00000  EMPTY 0 {}

	RW_SRAM_NCACHE 0x81E00000 EMPTY 0 {}
	USB_BUFFER +0{
		* (.usb_buf)
		*(*m_usb_dma_init_data)
		*(*m_usb_dma_noninit_data)
		}
	RW_SRAM_NCACHE_END 0x82000000 EMPTY 0 {}
}
