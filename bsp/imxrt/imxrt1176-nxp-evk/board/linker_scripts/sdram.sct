#!armclang -E --target=arm-arm-none-eabi -mcpu=cortex-m7 -xc

#define STACK_SIZE 0x2000
#define ROM_BASE	0x80000000
#define IVT_BASE	0x80001000
#define ITCM_SIZE	64*1024
#define DTCM_SIZE	(512-64)*1024
#define WILD_PTR_PLACEHOLDER  32

#define OCRAM       0x20240000
#define OCRAM_END   0x20340000
#define SDRAM2     	0x82000000
#define SDRAM2_END  0x84000000

#define OMV_MAIN_FB_SIZE	4*720*1280 //301*1024
#define OMV_FB_ALLOC_OVERLAY_SIZE	120*1024 //83*1024
#define OMV_FB_ALLOC_SIZE  1536*1024
; must use "VECTOR_RAM", "RW_m_data", "VECTOR_ROM" as names to work with "InstallIRQHandler()" API
#include "../../rtconfig.h"
LR_XIP_FLASH_INFO ROM_BASE  {
  ; >>> RO regions
	RW_m_config_text +0 0xF000 {
	* (.boot_hdr.conf, +FIRST)
	}
}

LR_XIP_FLASH_IVT IVT_BASE {
	ER_boot_hdr_ivt +0 0x20 {
	* (.boot_hdr.ivt)
	}
	ER_boot_hdr_boot_data +0 0x10{
	* (.boot_hdr.boot_data)
	}  
	ER_boot_hdr_dcd_data +0 {
	* (.boot_hdr.dcd_data)
	}
}

LR_XIP_FLASH ROM_BASE + 0x2000 {
	VECTOR_ROM +0 0x400 { ; vector table
		* (.isr_vector,+FIRST)
		* (InRoot$$Section)
	}
	
	TEXT_ROM +0  { ; load address = execution address
		.ANY (+RO)
	}


	ER_ITCM 0  +  WILD_PTR_PLACEHOLDER { ; Stack region growing down
		// vm.o pendsv.o objfun.o (+RO)
		// nlrthumb.o (+RO)
		// framebuffer.o fb_alloc.o (+RO)
		gc.o rt_mem*.o (+RO)
		collections.o array.o xalloc.o (+RO)
		arm_nn_mat*.o (+RO)
		jpeg.o (+RO)
		// obj.o objarray.o objfloat.o objlist.o objobject.o  (+RO)
		// objfun.o  nativeglue.o malloc.o (+RO)	
		// objdict.o  modmath.o modarray.o modbuiltins.o modmicropython.o map.o (+RO)
		/*
		acos*.o asin*.o atan*.o ceil*.o cos*.o erf*.o expf*.o expm*.o floor*.o fmod*.o (+RO)
		frexp*.o ldex*.o lgamma*.o log*.o modff.o nanf.o nearbyintf.o powf.o roundf.o (+RO)
		sin*.o sqrt*.o tan*.o tgammaf*.o trunc*.o dunder.o funder.o (+RO)
		*/
		* (.ram_code)
		usb_*.o (+RO)
	}
	
	; must align to 1024
	VECTOR_RAM AlignExpr(+0, 1024) EMPTY 0x400{
		
	}
#if EARLY_INIT_SEC
	ER_EARLY_INIT +0 {
		*(.early_init)
	}
#endif
	ER_ITCM_END ITCM_SIZE - WILD_PTR_PLACEHOLDER EMPTY 0 {}
	
    DTCM_START_PLACEHOLDER 0x20000000 EMPTY 0 {}
	ARM_LIB_STACK +0 EMPTY STACK_SIZE {}
	USB_BUFFER_LAYOUT +0{
		* (.qh_buffer_2kalign)
		*(*m_usb_dma_init_data)
		*(*m_usb_dma_noninit_data)
	}
	
	OVERLAY_CODE_Start +0 EMPTY 0 {}
	OVERLAY_CODE_BLOB +0  30*1024 {
		blob.o (+RO)
	}
	
	OVERLAY_FLASH +0  8*1024{
		fsl_flexspi.o (+RO)
		fsl_flash.o (+RO)
		*(.dtcm)
	}
	
	ER_DTCM +0 {
		.ANY (+RW, +ZI)
		sincos_tab.o (+RO)
		* (.ram_const)
		*(.dmaFramebuffer) ; the line buffer on the ram is helpful to save time
	}
	
	ER_LVGL_ZI_DATA +0 NOCOMPRESS{
		lv_*.o (+RW, +ZI)
	}
	
	WEIT_CACHE_AREA +0 EMPTY WEIT_CACHE_SIZE {}
	ARM_LIB_HEAP +0 EMPTY 0x3000 ; Heap region growing up
	{}
	ER_DTCM_END 0x20000000+DTCM_SIZE EMPTY 0{}
	
	ER_OCRAM OCRAM {
		*(.ocram)
		* (.jpeg_buf)
		yuv_tab.o (+RO)
	}
    OMV_FB_ALLOC_OVERLAY +0 EMPTY OMV_FB_ALLOC_OVERLAY_SIZE {}
	OMV_FB_ALLOC_OVERLAY_END +0 EMPTY 0 {}
	ER_OCRAM_END OCRAM_END EMPTY 0 {}

	RW_SRAM 0x81000000  EMPTY 0 {}	
	#define RTT_HEAP_SIZE 256*1024
	RTT_HEAP +0 EMPTY RTT_HEAP_SIZE{} 	
	
	
	RTT_MPY_THREAD_STACK +0 EMPTY NXP_MICROPYTHON_THREAD_STACK_SIZE{}
			
	RW_NoCache 0x81e00000 {
		* (NonCacheable.init)
		* (*NonCacheable)
	}
	
	USB_BUFFER +0{
		* (.usb_buf)
	}
				
	RW_SRAM_NCACHE_END 0x82000000 EMPTY 0 {}
	
	RW_SDRAM2 SDRAM2 EMPTY 0 {} 
	RW_LCD_BUFFER +0 {
		*(.lcd_buffer)
		* (.lcd_handshake_buffer)
	}
	OMV_MAIN_FB +0 EMPTY OMV_MAIN_FB_SIZE  + OMV_FB_ALLOC_SIZE {}
//	OMV_FB_ALLOC +0 EMPTY OMV_FB_ALLOC_SIZE {}
	OMV_FB_END +0 EMPTY 16 {}
	
	MPY_HEAP_START +0 EMPTY PKG_MICROPYTHON_HEAP_SIZE{}
	; <<<
	MPY_SENSOR_BUFER_START	+0 EMPTY 12*1024*1024{}
	; >>> SDRAM >>>
	ER_LCD_FB +0 UNINIT 1024*1024  {
		* (.lcd_fb)
	}
	
	RW_SDRAM2_END SDRAM2_END EMPTY 0 {}

}
